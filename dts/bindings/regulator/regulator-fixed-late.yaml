## dts/bindings/regulator/regulator-fixed-late.yaml
```yaml
# Copyright 2024 Anthony Asterisk Embedded Software, LLC
# Copyright 2019-2020 Peter Bigot Consulting, LLC
# Copyright 2023 EPAM Systems
# SPDX-License-Identifier: Apache-2.0

description: Fixed voltage regulators, Late init

include:
  - name: base.yaml
  - name: regulator.yaml
    property-allowlist:
      - regulator-name
      - regulator-boot-on
      - regulator-initial-mode
      - regulator-always-on
      - regulator-min-microvolt
      - regulator-max-microvolt

compatible: "regulator-fixed-late"

properties:
  regulator-name:
    required: true

  enable-gpios:
    type: phandle-array
    description: |
      GPIO to use to enable/disable the regulator.

      Unlike the gpio property in the Linux bindings this array must
      provide the GPIO polarity and open-drain status in the phandle
      selector.  The Linux enable-active-high and gpio-open-drain
      properties are not valid for Zephyr devicetree files.

  startup-delay-us:
    type: int
    default: 0
    description: Startup time, in microseconds

  off-on-delay-us:
    type: int
    default: 0
    description: Off delay time, in microseconds
```
